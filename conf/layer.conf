## conf/layer.conf
```bitbake
# We have a conf and classes directory, add to BBPATH
BBPATH .= ":${LAYERDIR}"

# We have recipes-* directories, add to BBFILES
BBFILES += "${LAYERDIR}/recipes-*/*/*.bb \
            ${LAYERDIR}/recipes-*/*/*.bbappend"

BBFILE_COLLECTIONS += "meta-inf-rauc"
BBFILE_PATTERN_meta-inf-rauc = "^${LAYERDIR}/"
BBFILE_PRIORITY_meta-inf-rauc = "6"

LAYERSERIES_COMPAT_meta-inf-rauc = "mickledore"
```
